#include <avr/io.h>

#include <util/delay.h>
#include "twihandler.h"
#include <avr/pgmspace.h>

#define OLEDI2CADDR 0x3C

#define CTRL_CMD 0x00
#define CTRL_DATA 0x40

/*#define OLED_DC PB1
#define OLED_RST PB0
#define OLED_CS PB2*/



static void oled_cmd( uint8_t cmd )
{   
    twi_start() ;
    twi_write( OLEDI2CADDR << 1 );
    twi_write( CTRL_CMD );
    twi_write( cmd ) ;
    twi_stop() ;
};


static void oled_data( const uint8_t * buf , uint16_t len )
{
    twi_start() ;
    twi_write( OLEDI2CADDR << 1 ) ;
    twi_write( CTRL_DATA );
	for( uint16_t i = 0 ; i < len ; i++ ){
		twi_write(buf[i]) ;
	}
    twi_stop() ;
}



static void oled_init(void)
{
    _delay_ms(100);

    oled_cmd(0xAE);                      // display off
    oled_cmd(0xD5); oled_cmd(0x80);  // clock divide
    oled_cmd(0xA8); oled_cmd(0x3F);  // multiplex = 64
    oled_cmd(0xD3); oled_cmd(0x00);  // display offset = 0
    oled_cmd(0x40);               // start line = 0
    oled_cmd(0x8D); oled_cmd(0x14);  // charge pump on
    oled_cmd(0x20); oled_cmd(0x00);  // horizontal addressing mode
    oled_cmd(0xA1);               // segment remap
    oled_cmd(0xC8);               // COM scan dir flipped
    oled_cmd(0xDA); oled_cmd(0x12);  // COM pins config
    oled_cmd(0x81); oled_cmd(0xCF);  // contrast
    oled_cmd(0xD9); oled_cmd(0xF1);  // pre-charge
    oled_cmd(0xDB); oled_cmd(0x40);  // VCOMH deselect
    oled_cmd(0xA4);                      // resume from RAM
    oled_cmd(0xA6);                      // normal (not inverted)
    oled_cmd(0xAF);                      // display on
}


static uint8_t framebuf[ 1024 ] ;


static const uint8_t f5x7[][5] PROGMEM = {
    {0x00,0x00,0x00,0x00,0x00}, // ' '
    {0x00,0x00,0x5F,0x00,0x00}, // '!'
    {0x00,0x07,0x00,0x07,0x00}, // '"'
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    {0x61,0x51,0x49,0x45,0x43}, // 'Z'
};

static const uint8_t font_5x7[][5] = {
    {0x3E,0x51,0x49,0x45,0x3E},  /* 0 */
    {0x00,0x42,0x7F,0x40,0x00},  /* 1 */
    {0x42,0x61,0x51,0x49,0x46},  /* 2 */
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    {0x44, 0x64, 0x54, 0x4C, 0x44}  // z
};




static void fb_clear(void)
{
    for ( uint16_t i = 0; i < 1024; i++) framebuf[i] = 0 ;
}


static void fb_set_pixel(uint8_t x, uint8_t y, uint8_t on) {
    if (x >= 128 || y >= 64 ) return;
    uint16_t idx = x + (y / 8) * 128;
    uint8_t bit = 1 << (y & 7);
    if (on) framebuf[idx] |= bit;
    else    framebuf[idx] &= ~bit;
}

static void fb_draw_char( uint8_t col , uint8_t page , char c )
{/*
    uint8_t idx;
    if ( c >= '0' && c <= '9' ) idx = c - '0' ;
    else if (c == ':') idx = 10 ;
    else if( c > '9'   &&   c < ('z'+1) ) idx = c - 86 ;
    else return ;

    uint16_t offset = page *128 + col ;

    for (uint8_t i = 0 ; i < 5 ; i++ ) {
        if (offset + i < 1024) {
            framebuf[ offset + i ] = font_5x7[idx][i] ;
        }
    }*/

    if (c < ' ' || c > 'Z') c = '?';
    uint8_t idx = c - ' ' ;
    for (uint8_t colm = 0; colm < 5; colm++) {
        uint8_t bits = pgm_read_byte(&f5x7[idx][colm]);
        for (uint8_t row = 0; row < 7; row++) {
            if (bits & (1 << row)) {
                fb_set_pixel(col + colm, page + row, 1);
            }
        }
    }
}


static void fb_draw_string( uint8_t col, uint8_t page, const char *s )
{
    while (*s) {
        fb_draw_char( col, page, *s++  );
        col += 6 ;  /* set 6 for 5 pixels + 1 space */
    }
}



static void oled_flush(void)
{
    oled_cmd(0x21); oled_cmd(0); oled_cmd(127) ;  /* Column range */
    oled_cmd(0x22); oled_cmd(0); oled_cmd(7) ;    /* Page range */
    //oled_data( framebuf , 1024 ) ;
    

    twi_start() ;
    twi_write( OLEDI2CADDR << 1 );
    twi_write( CTRL_DATA );
    for( uint16_t i = 0 ; i < 1024 ; i++)
    {
        twi_write( framebuf[i] );

    }
    twi_stop() ;
}
